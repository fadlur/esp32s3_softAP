## main/Kconfig.projbuild
```kconfig
menu "Example Configuration"

    config ESP_WIFI_SSID
        string "WiFi SSID"
        default "myssid"
        help
            SSID (network name) advertised by the soft-AP.

    config ESP_WIFI_PASSWORD
        string "WiFi Password"
        default "mypassword"
        help
            Password of the soft-AP (WPA/WPA2/WPA3). Leave empty for an open
            network. Use 8 to 63 characters for WPA2/WPA3.

    config ESP_WIFI_CHANNEL
        int "WiFi Channel"
        range 1 13
        default 1
        help
            WiFi channel (network channel) for the example to use.

    choice EXAMPLE_AP_AUTH_MODE
        prompt "WiFi security mode"
        default EXAMPLE_AP_AUTH_MODE_WPA2_WPA3 if ESP_WIFI_SOFTAP_SAE_SUPPORT
        default EXAMPLE_AP_AUTH_MODE_WPA2
        help
            Security mode of the soft-AP.

            WPA2/WPA3-PSK mixed mode is the most compatible choice: WPA3 capable
            stations use SAE, while stations with older drivers (for example
            older Windows versions) still connect with WPA2.
            WPA3-PSK only rejects stations that do not support SAE.

        config EXAMPLE_AP_AUTH_MODE_WPA2
            bool "WPA2-PSK (most compatible)"

        config EXAMPLE_AP_AUTH_MODE_WPA2_WPA3
            bool "WPA2/WPA3-PSK mixed (recommended)"
            depends on ESP_WIFI_SOFTAP_SAE_SUPPORT

        config EXAMPLE_AP_AUTH_MODE_WPA3
            bool "WPA3-PSK only"
            depends on ESP_WIFI_SOFTAP_SAE_SUPPORT
    endchoice

    config ESP_MAX_STA_CONN
        int "Maximal STA connections"
        default 4
        range 1 4 if IDF_TARGET_ESP32C2
        range 1 15
        help
            Maximum number of STAs allowed to connect to the soft-AP (wifi_config_t.ap.max_connection).
            Upper bound matches ESP_WIFI_MAX_CONN_NUM in esp_wifi_types_native.h:
            1-4 on ESP32-C2, 1-15 on other Wi-Fi chips.
            Soft-AP and ESP-NOW share encryption keys; see Wi-Fi driver documentation
            if ESP-NOW is enabled.

    config ESP_GTK_REKEYING_ENABLE
        bool "Enable GTK Rekeying"
        default y
        help
            Flag to enable GTK rekeying.

    config ESP_GTK_REKEY_INTERVAL
        int "GTK rekey interval"
        depends on ESP_GTK_REKEYING_ENABLE
        range 60 65535
        default 600
        help
            GTK rekeying interval in seconds.
endmenu
```
